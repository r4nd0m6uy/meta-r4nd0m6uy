## conf/layer.conf
```bitbake
# We have a conf and classes directory, add to BBPATH
BBPATH .= ":${LAYERDIR}"

# We have recipes-* directories, add to BBFILES
BBFILES += "${LAYERDIR}/recipes-*/*/*.bb ${LAYERDIR}/recipes-*/*/*.bbappend"

BBFILE_COLLECTIONS += "r4nd0m6uy"
BBFILE_PATTERN_r4nd0m6uy = "^${LAYERDIR}/"
BBFILE_PRIORITY_r4nd0m6uy = "1"
LAYERVERSION_r4nd0m6uy = "1"
LAYERDEPENDS_r4nd0m6uy = "core"
```
